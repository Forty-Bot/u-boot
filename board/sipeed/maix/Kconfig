## board/sipeed/maix/Kconfig
```kconfig
# SPDX-License-Identifier: GPL-2.0+
# Copyright (C) 2019 Sean Anderson <seanga2@gmail.com>

if TARGET_SIPEED_MAIX

config SYS_BOARD
	default "maix"

config SYS_VENDOR
	default "sipeed"

config SYS_CPU
	default "generic"

config SYS_CONFIG_NAME
	default "sipeed-maix"

config SYS_TEXT_BASE
	default 0x80000000

config DEFAULT_DEVICE_TREE
	default "k210-maix-bit"

config NR_CPUS
	default 2

config NR_DRAM_BANKS
	default 2

config SYS_MALLOC_F_LEN
	default 0x8000

config BOARD_SPECIFIC_OPTIONS
	def_bool y
	select GENERIC_RISCV
	select DM_SERIAL
	select SIFIVE_SERIAL
	select ARCH_DEFAULT_RV64I
	select ENV_IS_NOWHERE
	imply SIFIVE_CLINT
	imply K210_SYSCTL
	imply CLK_K210
	imply SPI
	imply DM_GPIO
	imply CMD_GPIO
	imply SYS_NS16550
	imply SYS_MALLOC_F
endif
```

## configs/sipeed_maix_bitm_defconfig
```kconfig
CONFIG_RISCV=y
CONFIG_ENV_SIZE=0x2000
CONFIG_ENV_SECT_SIZE=0x1000
CONFIG_ENV_OFFSET=0x7C000
CONFIG_ENV_OFFSET_REDUND=0x7E000
CONFIG_TARGET_SIPEED_MAIX=y
CONFIG_ARCH_RV64I=y
CONFIG_USE_BOOTCOMMAND=y
CONFIG_BOOTCOMMAND="sf probe;mtd read kernel 80000000;go 80000000"
CONFIG_MTDIDS_DEFAULT="nor0=spi3.0"
CONFIG_MTDPARTS_DEFAULT="spi3.0:496k(u-boot),16k(env),5632k(kernel),10240k(data)"
CONFIG_SYS_REDUNDAND_ENVIRONMENT=y
# CONFIG_NET is not set
# CONFIG_INPUT is not set
# CONFIG_DM_ETH is not set
# CONFIG_EFI_LOADER is not set
```

## drivers/clk/kendryte/Kconfig
```kconfig
config CLK_K210
	bool "Clock support for Kendryte K210"
	depends on K210_SYSCTL
	select CLK
	select CLK_CCF
	help
	  This enables support clock driver for Kendryte K210 platforms.
```

## drivers/pinctrl/kendryte/Kconfig
```kconfig
config PINCTRL_K210
	bool "Kendryte K210 Fully-Programmable Input/Output Array driver"
	depends on DM && PINCTRL_GENERIC
	help
	  Support pin multiplexing on the K210. The "FPIOA" can remap any
	  supported function to any multifunctional IO pin. It can also perform
	  basic GPIO functions, such as reading the current value of a pin.
```

## drivers/ram/sifive/Kconfig
```kconfig
config RAM_SIFIVE
	bool "Ram drivers support for SiFive SoCs"
	depends on RAM && RISCV
	default y
	help
	  This enables support for ram drivers of SiFive SoCs.

config SIFIVE_FU540_DDR
	bool "SiFive FU540 DDR driver"
	depends on RAM_SIFIVE
	default y if TARGET_SIFIVE_FU540
	select REGMAP
	select SPL_REGMAP if SPL
	help
	  This enables DDR support for the platforms based on SiFive FU540 SoC.
```
